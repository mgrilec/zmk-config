// Copyright 2023 Manna Harbour
// https://github.com/manna-harbour/miryoku

#include "temper-layouts.dtsi"

#include "../miryoku/custom_config.h"
#include "../miryoku/mapping/36/minidox.h"
#include "../miryoku/miryoku.dtsi"

/ {
    combos {
        compatible = "zmk,combos";

        studio_unlock_combo {
            bindings = <&studio_unlock>;
            key-positions = <14 24>;
            layers = <U_MEDIA>;
            timeout-ms = <50>;
        };
    };
};